## trunk/linux-3.4.x/drivers/nvram/Kconfig
```kconfig
menu "ASUS NVRAM"

config	ASUS_NVRAM_API
	tristate "ASUS NVRAM R/W API"
	depends on MTD_RALINK
	default y
	---help---
	ASUS NVRAM R/W API

config	ASUS_NVRAM_MTD_OFFSET
	hex "NVRAM offset in Config partition"
	depends on ASUS_NVRAM_API
	default 0x0
	---help---
	Byte offset of the NVRAM data area inside the Config partition.
endmenu
```
